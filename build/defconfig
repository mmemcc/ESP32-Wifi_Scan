## main/Kconfig.projbuild
```kconfig
menu "Example Configuration"

    config EXAMPLE_SCAN_LIST_SIZE
        int "Max size of scan list"
        range 0 50
        default 40
        help
            The size of array that will be used to retrieve the list of access points.

endmenu
```
